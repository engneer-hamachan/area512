## sdkconfig.defaults.2432s028
```kconfig
CONFIG_ESPTOOLPY_FLASHSIZE_4MB=y
CONFIG_ESPTOOLPY_FLASHSIZE="4MB"
CONFIG_PARTITION_TABLE_CUSTOM_FILENAME="partitions_2432s028.csv"
CONFIG_ESP_CONSOLE_UART_DEFAULT=y
# CONFIG_BT_ENABLED is not set
```
